## package/batocera/drivers/rtl8812au-dkms-module/Config.in
```kconfig
config BR2_PACKAGE_RTL8812AU_DKMS_MODULE
	bool "rtl8812au-dkms-module"
	depends on BR2_LINUX_KERNEL
```

## package/batocera/drivers/rtl8821ce-module/Config.in
```kconfig
config BR2_PACKAGE_RTL8821CE_MODULE
	bool "rtl8821ce-module"
	depends on BR2_LINUX_KERNEL
```

## package/batocera/utils/batocera-wine/Config.in
```kconfig
config BR2_PACKAGE_BATOCERA_WINE
	bool "batocera-wine"
	select BR2_PACKAGE_WINE
        select BR2_PACKAGE_WINE_X86          if BR2_PACKAGE_BATOCERA_TARGET_X86_64

        select BR2_PACKAGE_WINETRICKS
	select BR2_PACKAGE_CABEXTRACT
	select BR2_PACKAGE_SQUASHFS
	select BR2_PACKAGE_PYTHON_PYGAME
        select BR2_PACKAGE_PYTHON_PYGAME_FONT
        select BR2_PACKAGE_LIBMSPACK
        select BR2_PACKAGE_YAD
        select BR2_PACKAGE_GSTREAMER1
        select BR2_PACKAGE_GST1_LIBAV
        select BR2_PACKAGE_GST1_PLUGINS_BASE
        select BR2_PACKAGE_GST1_PLUGINS_GOOD
```
